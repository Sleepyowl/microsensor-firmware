## boards/BeeEye/MPsensor/Kconfig.MPsensor
```kconfig
config BOARD_MPSENSOR
	select SOC_NRF54L15_CPUAPP if BOARD_MPSENSOR_NRF54L15_CPUAPP
	select SOC_NRF54L15_CPUFLPR if \
		BOARD_MPSENSOR_NRF54L15_CPUFLPR || \
		BOARD_MPSENSOR_NRF54L15_CPUFLPR_XIP
```

## boards/BeeEye/MPsensor/board.yml
```yaml
board:
  name: MPsensor
  vendor: BeeEye
  socs:
  - name: nrf54l15
    variants:
    - name: xip
      cpucluster: cpuflpr
```
